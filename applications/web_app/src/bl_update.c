/*
 * Bootloader self-update (see BOOTLOADER.md, "Updating the bootloader").
 *
 * `make ota-bootloader` signs MCUboot's binary like an application image and
 * uploads it to slot 1 without marking it for test, so MCUboot leaves it
 * alone. Once this (confirmed) firmware is online it checks slot 1: a staged
 * image whose payload is an ESP bootloader (magic 0xE9) is verified (SHA-256
 * and ECDSA P-256 signature with the key that signs our firmware) and copied
 * to the boot partition at 0x0, where the ROM loads it from.
 *
 * The flash contents are the resume state: only 4 KB sectors that differ
 * from the staged image are erased and programmed, so repeating after an
 * interruption costs nothing, and an identical bootloader is never touched.
 * After a SHA-256 read-back of 0x0 matches, slot 1 is erased.
 */

#include <string.h>
#include <zephyr/kernel.h>
#include <zephyr/logging/log.h>
#include <zephyr/storage/flash_map.h>
#include <bootutil/image.h>
#include <mbedtls/sha256.h>
#include <mbedtls/ecdsa.h>

#include "app.h"

LOG_MODULE_REGISTER(bl_update, LOG_LEVEL_INF);

#define ESP_IMAGE_MAGIC 0xE9
#define SECTOR          4096
#define CHUNK           512

/* SubjectPublicKeyInfo (DER) of the signing key, generated by CMake */
static const uint8_t pubkey_der[] = {
#include "bl_pubkey.inc"
};

static uint8_t buf_a[CHUNK], buf_b[CHUNK];
static char result[24] = "none";

/* SHA-256 of len bytes of fa from off */
static int hash_area(const struct flash_area *fa, off_t off, size_t len, uint8_t out[32])
{
	mbedtls_sha256_context ctx;
	int ret = 0;

	mbedtls_sha256_init(&ctx);
	mbedtls_sha256_starts(&ctx, 0);
	while (len > 0 && ret == 0) {
		size_t n = MIN(len, CHUNK);

		ret = flash_area_read(fa, off, buf_a, n);
		mbedtls_sha256_update(&ctx, buf_a, n);
		off += n;
		len -= n;
	}
	mbedtls_sha256_finish(&ctx, out);
	mbedtls_sha256_free(&ctx);
	return ret;
}

static int verify_sig(const uint8_t hash[32], const uint8_t *sig, size_t sig_len)
{
	mbedtls_ecdsa_context ecdsa;
	int ret;

	mbedtls_ecdsa_init(&ecdsa);
	/* The uncompressed point is the last 65 bytes of the DER key */
	ret = mbedtls_ecp_group_load(&ecdsa.MBEDTLS_PRIVATE(grp), MBEDTLS_ECP_DP_SECP256R1);
	if (ret == 0) {
		ret = mbedtls_ecp_point_read_binary(&ecdsa.MBEDTLS_PRIVATE(grp),
						    &ecdsa.MBEDTLS_PRIVATE(Q),
						    pubkey_der + sizeof(pubkey_der) - 65, 65);
	}
	if (ret == 0) {
		ret = mbedtls_ecdsa_read_signature(&ecdsa, hash, 32, sig, sig_len);
	}
	mbedtls_ecdsa_free(&ecdsa);
	return ret;
}

/* Checks the staged image's SHA-256 and signature TLVs */
static int verify_staged(const struct flash_area *fa, const struct image_header *hdr)
{
	struct image_tlv_info info;
	struct image_tlv tlv;
	uint8_t hash[32], sig[80];
	bool hash_ok = false, sig_ok = false;
	off_t off = hdr->ih_hdr_size + hdr->ih_img_size + hdr->ih_protect_tlv_size;
	off_t end;

	if (hash_area(fa, 0, off, hash) ||
	    flash_area_read(fa, off, &info, sizeof(info)) ||
	    info.it_magic != IMAGE_TLV_INFO_MAGIC) {
		return -EINVAL;
	}
	end = off + info.it_tlv_tot;
	for (off += sizeof(info); off + sizeof(tlv) <= end; off += sizeof(tlv) + tlv.it_len) {
		if (flash_area_read(fa, off, &tlv, sizeof(tlv))) {
			return -EIO;
		}
		if (tlv.it_type == IMAGE_TLV_SHA256 && tlv.it_len == 32) {
			flash_area_read(fa, off + sizeof(tlv), sig, 32);
			hash_ok = memcmp(sig, hash, 32) == 0;
		} else if (tlv.it_type == IMAGE_TLV_ECDSA_SIG && tlv.it_len <= sizeof(sig)) {
			flash_area_read(fa, off + sizeof(tlv), sig, tlv.it_len);
			sig_ok = verify_sig(hash, sig, tlv.it_len) == 0;
		}
	}
	return hash_ok && sig_ok ? 0 : -EPERM;
}

/* Makes boot[0..len) equal to the staged payload, one differing sector at a time */
static int copy_payload(const struct flash_area *src, off_t src_off,
			const struct flash_area *dst, size_t len)
{
	for (off_t sec = 0; sec < len; sec += SECTOR) {
		size_t sec_len = MIN(SECTOR, len - sec);
		bool same = true;
		int ret;

		for (off_t o = 0; o < sec_len && same; o += CHUNK) {
			size_t n = MIN(CHUNK, sec_len - o);

			if (flash_area_read(src, src_off + sec + o, buf_a, n) ||
			    flash_area_read(dst, sec + o, buf_b, n)) {
				return -EIO;
			}
			same = memcmp(buf_a, buf_b, n) == 0;
		}
		if (same) {
			continue;
		}

		ret = flash_area_erase(dst, sec, SECTOR);
		for (off_t o = 0; o < sec_len && ret == 0; o += CHUNK) {
			size_t n = MIN(CHUNK, sec_len - o);

			ret = flash_area_read(src, src_off + sec + o, buf_a, n);
			if (ret == 0) {
				/* Writes are word-aligned; pad with erased bytes */
				memset(buf_a + n, 0xFF, ROUND_UP(n, 4) - n);
				ret = flash_area_write(dst, sec + o, buf_a, ROUND_UP(n, 4));
			}
		}
		if (ret) {
			return ret;
		}
		LOG_INF("Bootloader sector 0x%05lx written", (long)sec);
	}
	return 0;
}

void bl_update_check(void)
{
	const struct flash_area *slot, *boot;
	struct image_header hdr;
	uint8_t magic, want[32], got[32];
	int ret;

	if (flash_area_open(FIXED_PARTITION_ID(slot1_partition), &slot) ||
	    flash_area_open(FIXED_PARTITION_ID(boot_partition), &boot)) {
		return;
	}
	/* Nothing staged, or an application image: not ours */
	if (flash_area_read(slot, 0, &hdr, sizeof(hdr)) || hdr.ih_magic != IMAGE_MAGIC ||
	    flash_area_read(slot, hdr.ih_hdr_size, &magic, 1) || magic != ESP_IMAGE_MAGIC) {
		goto out;
	}
	if (hdr.ih_img_size > boot->fa_size || verify_staged(slot, &hdr)) {
		LOG_ERR("Staged bootloader rejected (bad size, hash or signature)");
		strcpy(result, "rejected");
		goto out;
	}

	LOG_INF("Installing staged bootloader (%u bytes)", hdr.ih_img_size);
	ret = copy_payload(slot, hdr.ih_hdr_size, boot, hdr.ih_img_size);
	if (ret == 0) {
		ret = hash_area(slot, hdr.ih_hdr_size, hdr.ih_img_size, want) ||
		      hash_area(boot, 0, hdr.ih_img_size, got) ||
		      memcmp(want, got, sizeof(want)) ? -EIO : 0;
	}
	if (ret) {
		/* Staging stays in slot 1, the next check tries again */
		LOG_ERR("Bootloader write failed (%d), will retry", ret);
		strcpy(result, "failed, retrying");
		goto out;
	}

	flash_area_erase(slot, 0, SECTOR);
	snprintk(result, sizeof(result), "installed %02X%02X%02X%02X", got[0], got[1], got[2],
		 got[3]);
	LOG_INF("Bootloader %s, verified", result);
out:
	flash_area_close(slot);
	flash_area_close(boot);
}

const char *bl_update_result(void)
{
	return result;
}
